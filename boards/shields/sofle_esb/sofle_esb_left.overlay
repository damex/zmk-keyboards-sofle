#include "sofle_esb.dtsi"

/ {
    chosen {
        zmk,esb-self = &sofle_left_peripheral;
    };
};

&kscan0 {
    debounce-press-ms = <10>;
    debounce-release-ms = <20>;
};

&left_encoder {
    compatible = "zmk,stepped-encoder";
};
