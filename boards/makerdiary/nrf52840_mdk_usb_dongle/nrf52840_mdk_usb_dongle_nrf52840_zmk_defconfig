## boards/makerdiary/nrf52840_mdk_usb_dongle/nrf52840_mdk_usb_dongle_nrf52840_zmk_defconfig
```kconfig
CONFIG_ARM_MPU=y
CONFIG_CONSOLE=y
CONFIG_SERIAL=y
CONFIG_UART_CONSOLE=y
CONFIG_HW_STACK_PROTECTION=y
CONFIG_GPIO=y
CONFIG_ZMK_BLE=y
CONFIG_ZMK_USB=y
CONFIG_MPU_ALLOW_FLASH_WRITE=y
CONFIG_NVS=y
CONFIG_SETTINGS_NVS=y
CONFIG_FLASH=y
CONFIG_FLASH_PAGE_LAYOUT=y
CONFIG_FLASH_MAP=y
```

## boards/shields/sofle_esb/Kconfig.defconfig
```kconfig
if SHIELD_SOFLE_ESB_DONGLE

config ZMK_KEYBOARD_NAME
    default "Sofle Dongle"

config ZMK_SPLIT_ROLE_CENTRAL
    default y

endif # SHIELD_SOFLE_ESB_DONGLE

if SHIELD_SOFLE_ESB_RELAY_DONGLE

config ZMK_KEYBOARD_NAME
    default "Sofle ESB Relay Dongle"

endif # SHIELD_SOFLE_ESB_RELAY_DONGLE
```

## boards/shields/sofle_esb/Kconfig.shield
```kconfig
config SHIELD_SOFLE_ESB_DONGLE
    def_bool $(shields_list_contains,sofle_esb_dongle)

config SHIELD_SOFLE_ESB_LEFT
    def_bool $(shields_list_contains,sofle_esb_left)

config SHIELD_SOFLE_ESB_RIGHT
    def_bool $(shields_list_contains,sofle_esb_right)

config SHIELD_SOFLE_ESB_RELAY_LEFT
    def_bool $(shields_list_contains,sofle_esb_relay_left)

config SHIELD_SOFLE_ESB_RELAY_RIGHT
    def_bool $(shields_list_contains,sofle_esb_relay_right)

config SHIELD_SOFLE_ESB_RELAY_DONGLE
    def_bool $(shields_list_contains,sofle_esb_relay_dongle)
```

## config/west.yml
```yaml
---
manifest:
  defaults:
      revision: 9ebbeff0a8b69a42f14aec022cdf16c7a107b9e0
  remotes:
    - name: zmkfirmware
      url-base: https://github.com/zmkfirmware
    - name: zephyrproject-rtos
      url-base: https://github.com/zephyrproject-rtos
    - name: damex
      url-base: https://github.com/damex
  projects:
    - name: zmk
      remote: zmkfirmware
      import: app/west.yml
    - name: mcuboot
      remote: zephyrproject-rtos
      revision: 346f7374ff4467e40b5594658f8ac67a5e9813c9
      path: bootloader/mcuboot
    - name: zmk-feature-split-esb
      remote: damex
      revision: v0.6.4
      import: true
    - name: zmk-driver-stepped-encoder
      remote: damex
      revision: v0.1.0
  self:
    path: config
```
